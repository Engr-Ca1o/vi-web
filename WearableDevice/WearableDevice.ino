#include <GxEPD2_BW.h>
#include <Fonts/FreeMonoBold9pt7b.h>
#include <Fonts/FreeMonoBold18pt7b.h>  // Larger Font for Message
#include "GxEPD2_display_selection_new_style.h"
#include <SPI.h>
#include <LoRa.h>
#include <Wire.h>
#include "Adafruit_DRV2605.h"

Adafruit_DRV2605 drv;

// LoRa Configuration
#define SS  5    // LoRa module CS
#define RST 14   // LoRa module RESET
#define DI0 26    // LoRa module IRQ

String lastMessage = "...";  // Last received message
String currentMessage = "...";  // Default startup message

void setup() {
  Serial.begin(115200);
    
  // Initialize Display
  display.init(115200, true, 2, false);
  display.setRotation(1);
  display.setFont(&FreeMonoBold9pt7b);
  display.setTextColor(GxEPD_BLACK);

  if (! drv.begin()) {
    Serial.println("Could not find DRV2605");
    while (1) delay(10);
  }
 
  drv.selectLibrary(1);
  drv.setMode(DRV2605_MODE_INTTRIG); 

  // Show initial UI
  showMessage();

  // Initialize LoRa
  LoRa.setPins(SS, RST, DI0);
  if (!LoRa.begin(433E6)) {  
    Serial.println("LoRa init failed!");
    currentMessage = "LoRa Init Failed!";
    showMessage();
    while (1);
  }

  LoRa.setSpreadingFactor(7);
  LoRa.setSignalBandwidth(125E3);
  LoRa.setCodingRate4(5);
  LoRa.setTxPower(17,true);

  Serial.println("LoRa Initialized.");
}

void loop() {
  // Check for incoming LoRa messages
  int packetSize = LoRa.parsePacket();
  if (packetSize) {
    drv.setWaveform(0, 58);
    drv.setWaveform(0, 58);
    drv.setWaveform(0, 58);
    drv.setWaveform(0, 58);
    drv.setWaveform(0, 58);
    drv.setWaveform(1, 0);    // end waveform

    // play the effect!
    drv.go();

    lastMessage = currentMessage; // Store previous message
    currentMessage = "";  // Reset current message

    while (LoRa.available()) {
      currentMessage += (char)LoRa.read();  // Read full message
    }

    Serial.print("Received: ");
    Serial.println(currentMessage);

        // Update Display
    showMessage();
   
  }
}

void showMessage() {
    display.setPartialWindow(0, 0, display.width(), display.height());
    display.firstPage();
    do {
        display.fillScreen(GxEPD_WHITE);

        // Draw border
        display.drawRect(0, 0, display.width(), display.height(), GxEPD_BLACK);

        // Top Section (Static Utils)
        display.setFont(&FreeMonoBold9pt7b);
        display.setCursor(10, 15);
        display.print("Status: Active");

        // Bottom Section (Static Utils)
        display.setCursor(10, display.height() - 10);
        display.print("Last: " + lastMessage);

        // Middle Section (Current Message with Larger Font)
        display.setFont(&FreeMonoBold18pt7b);
        int16_t tbx, tby;
        uint16_t tbw, tbh;
        display.getTextBounds(currentMessage.c_str(), 0, 0, &tbx, &tby, &tbw, &tbh);
        uint16_t x = ((display.width() - tbw) / 2) - tbx;
        uint16_t y = ((display.height() / 2) - tbh / 2) - tby;
        display.setCursor(x, y);
        display.print(currentMessage);
        
    } while (display.nextPage());
}


// 'Car_pictogram', 60x60px
const unsigned char car_symbolCar_pictogram [] PROGMEM = {
	0xff, 0xff, 0xff, 0xff, 0xff, 0xff, 0xff, 0xf0, 0xff, 0xff, 0xff, 0xff, 0xff, 0xff, 0xff, 0xf0, 
	0xff, 0xff, 0xff, 0xff, 0xff, 0xff, 0xff, 0xf0, 0xff, 0xff, 0xff, 0xff, 0xff, 0xff, 0xff, 0xf0, 
	0xff, 0xff, 0xff, 0xff, 0xff, 0xff, 0xff, 0xf0, 0xff, 0xff, 0xff, 0xff, 0xff, 0xff, 0xff, 0xf0, 
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	0xff, 0xff, 0xff, 0xff, 0xff, 0xff, 0xff, 0xf0, 0xff, 0xff, 0xff, 0xff, 0xff, 0xff, 0xff, 0xf0
};

// Array of all bitmaps for convenience. (Total bytes used to store images in PROGMEM = 496)
const int car_symbolallArray_LEN = 1;
const unsigned char* car_symbolallArray[1] = {
	car_symbolCar_pictogram
};


// 'motor', 50x50px
const unsigned char motor_symbolmotor [] PROGMEM = {
	0xff, 0xff, 0xff, 0xff, 0xff, 0xff, 0xc0, 0xff, 0xff, 0xff, 0xff, 0xff, 0xff, 0xc0, 0xff, 0xff, 
	0xff, 0xff, 0xff, 0xff, 0xc0, 0xff, 0xff, 0xff, 0xff, 0xff, 0xff, 0xc0, 0xff, 0xff, 0xff, 0xff, 
	0xff, 0xff, 0xc0, 0xff, 0xff, 0xff, 0xff, 0xff, 0xff, 0xc0, 0xff, 0xff, 0xff, 0xff, 0xff, 0xff, 
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	0xff, 0xff, 0xff, 0xff, 0xff, 0xff, 0xc0, 0xff, 0xff, 0xff, 0xff, 0xff, 0xff, 0xc0
};

// Array of all bitmaps for convenience. (Total bytes used to store images in PROGMEM = 368)
const int motor_symbolallArray_LEN = 1;
const unsigned char* motor_symbolallArray[1] = {
	motor_symbolmotor
};



